## ANDROID_2.6.32/drivers/media/video/wmt/encode/jpeg/Kconfig
```kconfig
#
# Multimedia Video device configuration
#

config WMT_VIDEO_ENCODE_JPEG
	tristate "WonderMedia Hardware JPEG encoder"
	---help---
	  Say Y here to use hardware to encode JPEG files	
  

 	
```

## ANDROID_2.6.32/drivers/media/video/wmt_v4l2/cmos/Kconfig
```kconfig
#
# Multimedia Video device configuration
#

config WMT_V4L2_CMOS
	bool "WonderMedia Hardware CMOS Support"
	default y
	---help---
	  Say Y here to use hardware CMOS Support.

choice
	prompt "Select CMOS external device"
	depends on (WMT_V4L2_CMOS)
	default WMT_V4L2_CMOS_OV7670

config WMT_V4L2_CMOS_OV7670
	bool "OV7670 selected"
	help
        If you have a OV7670 CMOS on board,
	    say Y here.

config WMT_V4L2_CMOS_OV7675
	bool "OV7675 selected"
	help
        If you have a OV7675 CMOS on board,
	    say Y here.


config WMT_V4L2_CMOS_OV2640
	bool "OV2640 selected"
	help
        If you have a OV2640 CMOS on board,
	    say Y here.

endchoice  	
  

 	
```

## ANDROID_2.6.32/drivers/mmc1/Kconfig
```kconfig
#
# MMC subsystem configuration
#

menuconfig MMC1
	tristate "MMC/SD/SDIO1 card support"
	depends on HAS_IOMEM
	help
	  This selects MultiMediaCard, Secure Digital and Secure
	  Digital I/O support.

	  If you want MMC/SD/SDIO support, you should say Y here and
	  also to your specific host controller driver.

config MMC1_DEBUG
	bool "MMC1 debugging"
	depends on MMC1 != n
	help
	  This is an option for use by developers; most people should
	  say N here.  This enables MMC core and driver debugging.

if MMC1

source "drivers/mmc1/core/Kconfig"

source "drivers/mmc1/card/Kconfig"

source "drivers/mmc1/host/Kconfig"

endif # MMC
```

## ANDROID_2.6.32/drivers/sdio/Kconfig
```kconfig
#
# MMC subsystem configuration
#

menuconfig MMC_SDIO
	tristate "MMC_SDIO support"
	depends on HAS_IOMEM
	help
	  This selects MultiMediaCard, Secure Digital and Secure
	  Digital I/O support.

	  If you want MMC/SD/SDIO support, you should say Y here and
	  also to your specific host controller driver.

config MMC_SDIO_DEBUG
	bool "MMC_SDIO debugging"
	depends on MMC_SDIO != n
	help
	  This is an option for use by developers; most people should
	  say N here.  This enables MMC core and driver debugging.

if MMC_SDIO

source "drivers/sdio/core/Kconfig"

source "drivers/sdio/card/Kconfig"

source "drivers/sdio/host/Kconfig"

endif # MMC
```

## ANDROID_2.6.32/drivers/sdio/host/Kconfig
```kconfig
#
# MMC/SD host controller drivers
#

comment "MMC/SD/SDIO Host Controller Drivers"

config MMC_SPI
	tristate "MMC/SD/SDIO over SPI"
	depends on SPI_MASTER && !HIGHMEM && HAS_DMA
	select CRC7
	select CRC_ITU_T
	help
	  Some systems access MMC/SD/SDIO cards using a SPI controller
	  instead of using a "native" MMC/SD/SDIO controller.  This has a
	  disadvantage of being relatively high overhead, but a compensating
	  advantage of working on many systems without dedicated MMC/SD/SDIO
	  controllers.

	  If unsure, or if your system has no SPI master driver, say N.


config MMC_ATSMB	
	tristate "WonderMedia ATSMB(AHB To MMC/SD BUS)"	
	help	  
		This selects the WMT Secure digital and Multimedia card Interface.	  
		If you have a machine with WonderMedia ATSMB, say Y or M here.	  	  

		If unsure, say N.	  
```
